## FreeRTOS.Esp32/Components/heap/Kconfig
```kconfig
menu "Heap memory"

    config CLUSTER_GROUP_SIZE
        int "Group-size of heap map"
        default 10
        help
            Free space is mapped in a cluster
            This is the group size of the map

            See http://github.com/svenbieg/heap for more details

    choice HEAP_TRACING_DEST
        bool "Heap tracing"
        default HEAP_TRACING_OFF
        help
            Enables the heap tracing API defined in esp_heap_trace.h.

            This function causes a moderate increase in IRAM code side and a minor increase in heap function
            (malloc/free/realloc) CPU overhead, even when the tracing feature is not used.
            So it's best to keep it disabled unless tracing is being used.

        config HEAP_TRACING_OFF
            bool "Disabled"
        config HEAP_TRACING_STANDALONE
            bool "Standalone"
            select HEAP_TRACING
        config HEAP_TRACING_TOHOST
            bool "Host-based"
            select HEAP_TRACING
    endchoice

    config HEAP_TRACING
        bool
        default F
        help
            Enables/disables heap tracing API.

    config HEAP_TRACING_STACK_DEPTH
        int "Heap tracing stack depth"
        range 0 10
        default 2
        depends on HEAP_TRACING
        help
            Number of stack frames to save when tracing heap operation callers.

            More stack frames uses more memory in the heap trace buffer (and slows down allocation), but
            can provide useful information.

endmenu
```
